BO_ 1234 Test : 4 Vector__XXX
 SG_ Signal0 : 0|32@1+ (1,0) [0|0] "unit" Vector__XXX
 SG_ Singal%1 : 0|8@1+ (1,0) [0|0] "unit" Vector__XXX

SIG_VALTYPE_ 1234 Signal0: 1;
