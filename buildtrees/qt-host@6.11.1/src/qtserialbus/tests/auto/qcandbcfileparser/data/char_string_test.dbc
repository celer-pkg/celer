BO_ 1234 Test : 8 Vector__XXX
 SG_ s0 : 0|8@1+ (1,0) [0|0] " !#$%&'()*+,-./0123456789:;<=>?@ABCDEFGHIJKLMNOPQRSTUVWXYZ[]^_`abcdefghijklmnopqrstuvwxyz{|}~°" Vector__XXX
 SG_ s1 : 0|8@1+ (1,0) [0|0] "double quote: "" Vector__XXX
 SG_ s2 : 0|8@1+ (1,0) [0|0] "backslash: \" Vector__XXX
