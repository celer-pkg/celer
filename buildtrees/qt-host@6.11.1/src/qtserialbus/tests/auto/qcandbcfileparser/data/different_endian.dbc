BO_ 1234 Test : 3 Vector__XXX
 SG_ s0 : 0|12@1+ (1,0) [0|0] "unit" Vector__XXX
 SG_ s1 : 23|8@0+ (1,0) [0|0] "" Vector__XXX
