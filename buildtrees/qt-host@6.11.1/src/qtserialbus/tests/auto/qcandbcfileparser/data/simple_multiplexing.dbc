VERSION ""

NS_ :

BS_:

BU_:

BO_ 1234 Test: 5 Vector__XXX
 SG_ s3 m2 : 8|32@1- (1,0) [0|0] "" Vector__XXX
 SG_ s2 m1 : 8|32@1- (1,0) [0|0] "" Vector__XXX
 SG_ s1 : 2|6@1+ (1,0) [0|0] "" Vector__XXX
 SG_ s0 M : 0|2@1+ (1,0) [0|0] "" Vector__XXX

BO_ 1235 Test1: 4 Vector__XXX
 SG_ s4 M : 0|8@1+ (1,0) [0|0] "" Vector__XXX
 SG_ s5 M : 8|8@1+ (1,0) [0|0] "" Vector__XXX
 SG_ s6 m1 : 16|8@1+ (1,0) [0|0] "" Vector__XXX
 SG_ s7 m2 : 24|8@1+ (1,0) [0|0] "" Vector__XXX

BA_DEF_  "BusType" STRING ;
BA_DEF_DEF_  "BusType" "CAN";
SIG_VALTYPE_ 1234 s3 : 1;
